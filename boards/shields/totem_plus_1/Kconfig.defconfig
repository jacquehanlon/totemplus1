## boards/shields/totem_plus_1/Kconfig.defconfig
```kconfig
if SHIELD_TOTEM_PLUS_1_LEFT

# Name must be less than 16 characters long!
config ZMK_KEYBOARD_NAME
    default "Totem Plus 1"

config ZMK_SPLIT_ROLE_CENTRAL
    default y

config ZMK_SPLIT_BLE_CENTRAL_PERIPHERALS
  default 1

config BT_MAX_CONN
  default 6

config BT_MAX_PAIRED
  default 6

endif

if SHIELD_TOTEM_PLUS_1_LEFT || SHIELD_TOTEM_PLUS_1_RIGHT

config ZMK_SPLIT
    default y

endif
```

## boards/shields/totem_plus_1/Kconfig.shield
```kconfig
config SHIELD_TOTEM_PLUS_1_LEFT
    def_bool $(shields_list_contains,totem_plus_1_left)

config SHIELD_TOTEM_PLUS_1_RIGHT
    def_bool $(shields_list_contains,totem_plus_1_right)
```
